/ {
    aliases {
        training-led = &led4_subnode_label;
    };

    led_childnode_path {
        compatible = "gpio-leds";

        led4_subnode_label: led4_path {
            gpios = <&gpio0 5 GPIO_ACTIVE_HIGH>;
        };
    };
};